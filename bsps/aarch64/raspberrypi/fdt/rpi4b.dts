/dts-v1/;

/ {
	#address-cells = <2>;
	#size-cells = <2>;

	axi {
		compatible = "simple-bus";
		#address-cells = <2>;
		#size-cells = <2>;

		interrupt-controller@40041000 {
			compatible = "arm,gic-400";
			#address-cells = <2>;
			#interrupt-cells = <3>;
			reg = <0x00 0x40041000 0x00 0x10000>;
			interrupt-controller;
			phandle = <0x01>;
		};

		ethernet@7d580000 {
			compatible = "brcm,genet-v5";
			status = "okay";
			interrupt-parent = <0x01>;
			interrupts = <0x00 0x39 0x04>;
			reg = <0x00 0x7d580000 0x00 0x1000>;
			phy-mode = "rgmii-rxid";
		};
	};
};

